#include <ESP8266WiFi.h>
#include <WiFiClient.h>
#ifndef UNIT_TEST
#include <Arduino.h>
#endif
#include <IRremoteESP8266.h>
#include <IRsend.h>

// Preencha com os dados de autenticaÃ§Ã£o do seu WiFi 
//variavel que armazena NOME da Rede WIFI(SSID)
const char ssid[] = "acesso";
//variavel que armazena Senha da Rede WIFI
const char psw[] = "12345678";
//IP do servidor do Site para comunicaÃ§Ã£o de recebimento de informaÃ§Ã£o
const char http_site[] = "http://192.168.137.1";
//Porta para comunicaÃ§Ã£o com o servidor do Site 80 padrÃ£o
const int http_port = 80;
//variavel para manipulaÃ§Ã£o dos dados do sensor

int est;
int temp;
int estant;
int tempant;
// VariÃ¡veis globais
WiFiClient client;
//IP do ESP (para voce acessar pelo browser - voce TEM que mudar este IP tambem)
IPAddress ip(192, 168, 137, 55);

//IP do roteador da sua rede wifi
IPAddress gateway(192, 168, 137, 1);

//Mascara de rede da sua rede wifi
IPAddress subnet(255, 255, 255, 0);

//IP do servidor do Site para comunicaÃ§Ã£o envio de informaÃ§Ã£o
IPAddress server1(192,168,137,1); 
//Porta do servidor do ESP 80 padrÃ£o
WiFiServer server(80);

#define IR_LED 4  // ESP8266 GPIO pin to use. Recommended: 4 (D2).

IRsend irsend(IR_LED);  // Set the GPIO to be used to sending the message.

// Example of data captured by IRrecvDumpV2.ino
uint16_t rawliga[199] = {4476, 4548, 520, 1676, 544, 592, 516, 1676, 540, 1680, 540, 592, 516,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 1688, 536};


uint16_t rawdesliga[199]= {4480, 4528, 544, 1672, 544, 592, 516, 1676, 544, 1676, 540, 592, 520,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 1684, 536};


uint16_t rawtemp17[199]= {4500, 4504, 564, 1656, 564, 560, 548, 1668, 552, 1648, 568, 560, 548,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 1652, 568};


uint16_t rawtemp18[199]= {4504, 4500, 572, 1648, 568, 560, 548, 1668, 552, 1648, 568, 560, 548,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 1652, 564}; 


uint16_t rawtemp19[199]= {4500, 4504, 564, 1652, 568, 560, 548, 1652, 568, 1652, 564, 564, 548,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 1652, 568};


uint16_t rawtemp20[199]= {4480, 4528, 544, 1692, 524, 592, 516, 1676, 544, 1676, 544, 588, 520,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 1676, 544};


uint16_t rawtemp21[199]= {4460, 4544, 528, 1692, 532, 604, 496, 1696, 532, 1668, 540, 612, 500,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 1676, 548};


uint16_t rawtemp22[199]= {4464, 4544, 524, 1692, 528, 612, 496, 1692, 528, 1692, 536, 600, 500,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 1676, 544};


uint16_t rawtemp23[199]= {4480, 4544, 528, 1672, 544, 588, 524, 1672, 544, 1676, 544, 588, 520,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 1672, 544};


uint16_t rawtemp24[199]= {4504, 4500, 572, 1648, 572, 556, 552, 1648, 568, 1652, 568, 560, 548,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 1648, 568};


uint16_t rawtemp25[199]= {4460, 4544, 528, 1692, 528, 608, 500, 1692, 528, 1688, 528, 612, 496,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 1692, 528};


uint16_t rawtemp26[199]= {4480, 4544, 524, 1676, 544, 592, 516, 1676, 544, 1676, 544, 588, 520,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 1648, 568};


uint16_t rawtemp27[199]= {4480, 4524, 548, 1672, 544, 588, 520, 1676, 544, 1692, 528, 588, 520,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 1648, 572};


uint16_t rawtemp28[199]= {4464, 4528, 560, 1656, 560, 572, 520, 1676, 560, 1656, 560, 576, 520,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 1652, 568};


uint16_t rawtemp29[199]= {4476, 4528, 544, 1676, 544, 588, 520, 1676, 544, 1684, 536, 584, 524,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 1696, 524};


uint16_t rawtemp30[199]= {4480, 4528, 540, 1676, 544, 592, 516, 1676, 544, 1672, 548, 588, 520,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 1676, 544};


void setup() {
 
  //Serial.begin(9600); // Vamos usar para debug
  irsend.begin();
  Serial.begin(115200, SERIAL_8N1, SERIAL_TX_ONLY);

  Serial.println();
  Serial.println();
  Serial.print("Conectando com: ");
  Serial.println(ssid);
  WiFi.config(ip, gateway, subnet);
  WiFi.begin(ssid, psw);

  delay(10000);
 
  Serial.println("");
  Serial.println("WiFi conectado com sucesso");
  // Startando o servidor
  server.begin();
  Serial.print("Servidor startado em ");
  Serial.print("http://");
  Serial.print(WiFi.localIP());
  Serial.println("/");

    Serial.println("Ligando");  
    irsend.sendRaw(rawliga, 199, 38);  // Send a raw data capture at 38kHz.
    est = 1;
    estant = est;

    delay(2000);

    Serial.println("Temperatura: 17 ºC");  
    irsend.sendRaw(rawtemp17, 199, 38);  // Send a raw data capture at 38kHz.
    temp = 17;
    tempant = temp;

     if ( !getPage((int)est,(int)temp) ) {
      Serial.println("GET request failed");
    }
}

void loop() {
  // put your main code here, to run repeatedly:
  if (est != estant || temp != tempant){
    if ( !getPage((int)est,(int)temp) ) {
      Serial.println("GET request failed");
    }
    estant = est;
    tempant = temp;
  }
  //Espera o recebimento de um camando enviado via GET pelo servidor
  WiFiClient client = server.available();
  if (!client) {
    return;
  }
  // Leitura do comando recebido
  Serial.print("Mensagem do cliente: ");
  String request = client.readStringUntil('\r');
  Serial.println(request);
  client.flush();
  if (request.indexOf("/LED=1") != -1) {
    Serial.println("Ligando");  
    irsend.sendRaw(rawliga, 199, 38);  // Send a raw data capture at 38kHz.
    est = 1;
  }
  if (request.indexOf("/LED=2") != -1) {
    Serial.println("Desligado");  
    irsend.sendRaw(rawdesliga, 199, 38);  // Send a raw data capture at 38kHz.
    est = 0;
  }
  if (request.indexOf("/LED=3") != -1) {
    Serial.println("Temperatura: 17 ºC");  
    irsend.sendRaw(rawtemp17, 199, 38);  // Send a raw data capture at 38kHz.
    temp = 17;
  }
  if (request.indexOf("4") != -1) {
    Serial.println("Temperatura: 18 ºC");  
    irsend.sendRaw(rawtemp18, 199, 38);  // Send a raw data capture at 38kHz.
    temp = 18;
  }
  if (request.indexOf("5") != -1) {
    Serial.println("Temperatura: 19 ºC");  
    irsend.sendRaw(rawtemp19, 199, 38);  // Send a raw data capture at 38kHz.
    temp = 19;
  }
  if (request.indexOf("6") != -1) {
    Serial.println("Temperatura: 20 ºC");  
    irsend.sendRaw(rawtemp20, 199, 38);  // Send a raw data capture at 38kHz.
    temp = 20;
  }
  if (request.indexOf("7") != -1) {
    Serial.println("Temperatura: 21 ºC");  
    irsend.sendRaw(rawtemp21, 199, 38);  // Send a raw data capture at 38kHz.
    temp = 21;
  }
  if (request.indexOf("8") != -1) {
    Serial.println("Temperatura: 22 ºC");  
    irsend.sendRaw(rawtemp22, 199, 38);  // Send a raw data capture at 38kHz.
    temp = 22;
  }
   if (request.indexOf("9") != -1) {
    Serial.println("Temperatura: 23 ºC");  
    irsend.sendRaw(rawtemp23, 199, 38);  // Send a raw data capture at 38kHz.
    temp = 23;
  }
  
  if (request.indexOf("/LED=0") != -1) {
    Serial.println("Temperatura: 24 ºC");  
    irsend.sendRaw(rawtemp24, 199, 38);  // Send a raw data capture at 38kHz.
    temp = 24;
  }
  

}

bool getPage(int est, int temp) {
  if ( !client.connect(server1, http_port) ) {
    Serial.println("Falha na conexao com o site ");
    return false;
  }
  
  String param = "?est=" + String(est) + "&temp=" + String(temp); //Parâmetros com as leituras
  client.println("GET /insert_ar.php" + param);
  client.println("HTTP/1.1");
  Serial.println("User-Agent: Arduino");
  client.println("Accept: text/html");
  client.println("Host:");
  client.println(http_site);
  client.println("\r\n\r\n");
  client.println("Connection: close\r\n\r\n");
  client.println();
  client.println();

    // Informações de retorno do servidor para debug
  while(client.available()){
    String line = client.readStringUntil('\r');
    Serial.print(line);
  }
  return true;

  
}
